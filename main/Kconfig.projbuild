## main/Kconfig.projbuild
```kconfig
menu "Zello Client"

    choice ZELLO_BOARD
        prompt "Board"
        default ZELLO_BOARD_TDISPLAY_P4 if IDF_TARGET_ESP32P4
        default ZELLO_BOARD_TDECK
        help
            The board to build for: the T-Display-P4 or the Tanmatsu on the
            ESP32-P4, the T-Deck or the Wio Tracker L2 on the ESP32-S3.

        config ZELLO_BOARD_TDISPLAY_P4
            bool "LilyGO T-Display-P4"
            depends on IDF_TARGET_ESP32P4
        config ZELLO_BOARD_TANMATSU
            bool "Nicolai Electronics Tanmatsu"
            depends on IDF_TARGET_ESP32P4
        config ZELLO_BOARD_TDECK
            bool "LilyGO T-Deck / T-Deck Plus"
            depends on IDF_TARGET_ESP32S3
        config ZELLO_BOARD_WIO_TRACKER_L2
            bool "Seeed Wio Tracker L2"
            depends on IDF_TARGET_ESP32S3
    endchoice

    # 1 on the Tanmatsu, 0 elsewhere. The dependency rules in
    # main/idf_component.yml test this rather than ZELLO_BOARD_TANMATSU: an
    # int is written to sdkconfig on every target, a bool that is off isn't.
    config ZELLO_USE_BADGE_BSP
        int
        default 1 if ZELLO_BOARD_TANMATSU
        default 0

    choice ZELLO_NETWORK
        prompt "Zello network"
        default ZELLO_NETWORK_CONSUMER
        help
            Consumer is the public zello.io network. Work is a Zello Work
            network, reached as wss://zellowork.io/ws/<network>.

        config ZELLO_NETWORK_CONSUMER
            bool "Consumer (zello.io)"
        config ZELLO_NETWORK_WORK
            bool "Zello Work"
    endchoice

    config ZELLO_WORK_NETWORK
        string "Zello Work network name"
        default ""
        help
            The subdomain of your Zello Work network. Ignored on the consumer
            network.

    config ZELLO_USERNAME
        string "Default Zello username"
        default ""

    config ZELLO_PASSWORD
        string "Default Zello password"
        default ""

    config ZELLO_AUTH_TOKEN
        string "Default developer token"
        default ""
        help
            The JWT issued by the Zello developer console
            (https://developers.zello.com). Required on the consumer network.
            It is long, so entering it in the web config is usually easier
            than here or on the device keyboard.

    config ZELLO_CHANNEL
        string "Default channel"
        default ""
        help
            Channel joined at logon. Can be changed at runtime on screen, in
            the web config, or with the console command "channel <name>".

    config ZELLO_WIFI_SSID
        string "Default Wi-Fi SSID"
        default ""

    config ZELLO_WIFI_PASSWORD
        string "Default Wi-Fi password"
        default ""

endmenu
```
